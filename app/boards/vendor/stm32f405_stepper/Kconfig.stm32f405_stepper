## app/boards/vendor/stm32f405_stepper/Kconfig.stm32f405_stepper
```kconfig
# Copyright (c) 2026 Paul Reisch
# SPDX-License-Identifier: Apache-2.0

config BOARD_STM32F405_STEPPER
	select SOC_STM32F405XX
```

## app/boards/vendor/stm32f405_stepper/board.yml
```yaml
board:
  name: stm32f405_stepper
  full_name: STM32F405 Stepper
  vendor: custom
  socs:
    - name: stm32f405xx
```

## drivers/Kconfig
```kconfig
# Custom sensor drivers configuration
menu "Drivers"
rsource "sensor/Kconfig"
endmenu
```

## drivers/sensor/Kconfig
```kconfig
# Custom sensor drivers configuration
if SENSOR
rsource "as5047p/Kconfig"
endif # SENSOR
```

## drivers/sensor/as5047p/Kconfig
```kconfig
# Copyright (c) 2025
# SPDX-License-Identifier: Apache-2.0

config AS5047P
    bool "AMS AS5047P Magnetic Rotary Encoder"
    default y
    #depends on DT_HAS_AS5047P_ENABLED
    select SPI
    help
      Enable driver for the AS5047P high-resolution rotary position sensor.
```
